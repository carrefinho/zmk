## app/boards/carrefinho/niao_ch32x033/Kconfig.niao_ch32x033
```kconfig
# Copyright (c) 2026 The ZMK Contributors
# SPDX-License-Identifier: MIT

config BOARD_NIAO_CH32X033
	select SOC_CH32X035
	select ZMK_BOARD_COMPAT if BOARD_NIAO_CH32X033_CH32X035_ZMK
```

## app/boards/carrefinho/niao_ch32x033/niao_ch32x033_defconfig
```kconfig
# Copyright (c) 2026 The ZMK Contributors
# SPDX-License-Identifier: MIT

CONFIG_GPIO=y
```

## app/boards/kbdfans/tofu65/board.yml
```yaml
board:
  name: tofu65
  vendor: kbdfans
  socs:
  - name: rp2040
    variants:
    - name: zmk
  full_name: tofu65
```

## app/boards/kinesis/adv360pro/board.yml
```yaml
boards:
- name: adv360pro_left
  vendor: kinesis
  socs:
  - name: nrf52840
    variants:
    - name: zmk
  full_name: adv360pro_left
- name: adv360pro_right
  vendor: kinesis
  socs:
  - name: nrf52840
    variants:
    - name: zmk
  full_name: adv360pro_right
```

## app/boards/moergo/glove80/board.yml
```yaml
boards:
- name: glove80_rh
  vendor: moergo
  socs:
  - name: nrf52840
  full_name: glove80_rh
- name: glove80_lh
  vendor: moergo
  socs:
  - name: nrf52840
  full_name: glove80_lh
```

## app/boards/nicekeyboards/nice60/board.yml
```yaml
board:
  name: nice60
  vendor: nicekeyboards
  socs:
  - name: nrf52840
    variants:
    - name: zmk
  full_name: nice60
```

## app/boards/nordic/nrf54l15dk/board.yml
```yaml
board:
  extend: nrf54l15dk
  variants:
    - name: zmk
      qualifier: nrf54l15/cpuapp
```

## app/boards/nordic/nrf54lm20dk/Kconfig.nrf54lm20dk
```kconfig
config BOARD_NRF54LM20DK
    select SOC_NRF54LM20A_CPUAPP if BOARD_NRF54LM20DK_NRF54LM20A_CPUAPP_ZMK
    select ZMK_BOARD_COMPAT if BOARD_NRF54LM20DK_NRF54LM20A_CPUAPP_ZMK
```

## app/boards/nordic/nrf54lm20dk/board.yml
```yaml
board:
  extend: nrf54lm20dk
  variants:
    - name: zmk
      qualifier: nrf54lm20a/cpuapp
```

## app/boards/polarityworks/bt60/board.yml
```yaml
boards:
- name: bt60_hs
  vendor: polarityworks
  socs:
  - name: nrf52840
    variants:
    - name: zmk
  full_name: bt60_hs
- name: bt60
  vendor: polarityworks
  socs:
  - name: nrf52840
    variants:
    - name: zmk
  revision:
    format: major.minor.patch
    default: 2.0.0
    revisions:
    - name: 1.0.0
    - name: 2.0.0
  full_name: bt60
```

## app/boards/shields/iqs231b_test/Kconfig.defconfig
```kconfig
if SHIELD_IQS231B_TEST

config ZMK_KEYBOARD_NAME
	default "IQS231B Test"

config I2C
	default y

config ZMK_SENSOR_IQS231B
	default y

config ZMK_RTT_LOGGING
	default y

config LOG
	default y

endif
```

## app/boards/shields/iqs231b_test/Kconfig.shield
```kconfig
config SHIELD_IQS231B_TEST
	def_bool $(shields_list_contains,iqs231b_test)
	select ZMK_SENSOR_IQS231B
```

## app/boards/shields/ptr_dongle/Kconfig.shield
```kconfig
# Copyright (c) 2026 The ZMK Contributors
# SPDX-License-Identifier: MIT

config SHIELD_PTR_DONGLE
    def_bool $(shields_list_contains,ptr_dongle)
```

## app/boards/shields/ptr_periph/Kconfig.shield
```kconfig
# Copyright (c) 2026 The ZMK Contributors
# SPDX-License-Identifier: MIT

config SHIELD_PTR_PERIPH
    def_bool $(shields_list_contains,ptr_periph)
```

## app/boards/shields/tester_nrf54l15dk/Kconfig.shield
```kconfig
# Copyright (c) 2026 The ZMK Contributors
# SPDX-License-Identifier: MIT

config SHIELD_TESTER_NRF54L15DK_LEFT
    def_bool $(shields_list_contains,tester_nrf54l15dk_left)

config SHIELD_TESTER_NRF54L15DK_RIGHT
    def_bool $(shields_list_contains,tester_nrf54l15dk_right)
```

## app/module/boards/keycapsss/puchi_ble/board.yml
```yaml
board:
  name: puchi_ble
  vendor: keycapsss
  socs:
  - name: nrf52840
  full_name: puchi_ble
```

## app/module/boards/makerdiary/nrf52840_m2/board.yml
```yaml
board:
  name: nrf52840_m2
  vendor: makerdiary
  socs:
  - name: nrf52840
  full_name: nrf52840_m2
```

## app/module/boards/mechwild/pillbug/board.yml
```yaml
board:
  name: pillbug
  vendor: mechwild
  socs:
  - name: nrf52840
  full_name: pillbug
```

## app/module/boards/qmk/proton_c/board.yml
```yaml
board:
  name: proton_c
  vendor: qmk
  socs:
  - name: stm32f303xc
  full_name: proton_c
```
