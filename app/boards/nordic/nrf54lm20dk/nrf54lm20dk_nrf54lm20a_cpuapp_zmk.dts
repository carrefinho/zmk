/*
 * Copyright (c) 2026 The ZMK Contributors
 *
 * SPDX-License-Identifier: MIT
 */

#include <../boards/nordic/nrf54lm20dk/nrf54lm20dk_nrf54lm20a_cpuapp.dts>
#include <dt-bindings/zmk/matrix_transform.h>

/*
 * Hardware available out of the box (from upstream Zephyr DTS):
 *   - LEDs:   led0..led3 (P1.22, P1.25, P1.27, P1.28)
 *   - Buttons: button0..button3 with zephyr,code = INPUT_KEY_0..3,
 *              wired via gpio-keys (input subsystem).
 *   - UART:   uart20 / uart30 at 115200, console on uart20.
 *
 * ZMK consumes the upstream `&buttons` gpio-keys node directly through
 * its post-4.2 input bridge (chosen zmk,matrix-input). A 1x4 transform
 * maps the four push-buttons to keymap positions 0..3.
 *
 * Upstream `nrf54lm20dk_common.dtsi` declares the gpio-keys node as
 * anonymous `buttons {}` with no DT label, so reference by path.
 */

/ {
	chosen {
		zmk,matrix-input = &{/buttons};
		zmk,matrix-transform = &dk_transform;
	};

	dk_transform: dk_transform {
		compatible = "zmk,matrix-transform";
		rows = <1>;
		columns = <4>;
		map = <
			RC(0,0) RC(0,1) RC(0,2) RC(0,3)
		>;
	};

	/*
	 * USB HID via USBD-next. The upstream DK common dtsi already enables
	 * &usbhs and &vregusb (and sets zephyr_udc0 -> &usbhs). All we need
	 * is the function-side node that registers a HID device with the
	 * stack. The in-report-size has to cover the largest ZMK input
	 * report (mouse = 7 bytes with smooth scroll); 16 is a safe cap.
	 *
	 * TODO(#9-followup): when porting other boards, move this to a
	 * shared app/dts/usb_hid.dtsi auto-included when ZMK_USB=y.
	 */
	hid_dev_0: hid_dev_0 {
		compatible = "zephyr,hid-device";
		label = "HID0";
		protocol-code = "keyboard";
		in-report-size = <16>;
		in-polling-period-us = <1000>;
	};
};
