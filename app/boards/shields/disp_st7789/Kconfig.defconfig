## app/boards/shields/disp_st7789/Kconfig.defconfig
```kconfig
if SHIELD_DISP_ST7789_ADAFRUIT_172X320 || SHIELD_DISP_ST7789_ADAFRUIT_240X240 || SHIELD_DISP_ST7789_WAVESHARE_240X280

if DISPLAY

choice ST7789V_PIXEL_FORMAT
   default ST7789V_RGB565
endchoice

if LVGL

config LV_Z_BITS_PER_PIXEL
   default 16

choice LV_COLOR_DEPTH
   default LV_COLOR_DEPTH_16
endchoice

config LV_COLOR_16_SWAP
   default y

config LV_DPI_DEF
   default 261 if SHIELD_DISP_ST7789_ADAFRUIT_172X320 || SHIELD_DISP_ST7789_ADAFRUIT_240X240
   default 218 if SHIELD_DISP_ST7789_WAVESHARE_240X280

endif # LVGL

endif # DISPLAY

endif # SHIELDS
```

## app/boards/shields/disp_st7789/Kconfig.shield
```kconfig
config SHIELD_DISP_ST7789_ADAFRUIT_172X320
   def_bool $(shields_list_contains,disp_st7789_adafruit_172x320)

config SHIELD_DISP_ST7789_ADAFRUIT_240X240
   def_bool $(shields_list_contains,disp_st7789_adafruit_240x240)

config SHIELD_DISP_ST7789_WAVESHARE_240X280
   def_bool $(shields_list_contains,disp_st7789_waveshare_240x280)
```

## app/boards/shields/lcd_dongle_forager/Kconfig.defconfig
```kconfig
if FORAGER_DONGLE || FORAGER_DONGLE_LCD

config ZMK_KEYBOARD_NAME
    default "Forager"

config ZMK_SPLIT_ROLE_CENTRAL
    default y

config ZMK_USB
	default y

if FORAGER_DONGLE_LCD

choice ZMK_DISPLAY_STATUS_SCREEN
    default ZMK_DISPLAY_STATUS_SCREEN_CUSTOM
endchoice

choice ZMK_DISPLAY_WORK_QUEUE
    default ZMK_DISPLAY_WORK_QUEUE_DEDICATED
endchoice

# choice ST7789V_PIXEL_FORMAT
# 	default ST7789V_RGB565
# endchoice

# config LV_Z_VDB_SIZE
#     default 50

# config LV_DPI_DEF
#     default 261

# config LV_Z_BITS_PER_PIXEL
# 	default 16

# choice LV_COLOR_DEPTH
# 	default LV_COLOR_DEPTH_16
# endchoice

# config LV_COLOR_16_SWAP
# 	default y

endif

endif

if FORAGER_DONGLE || FORAGER_DONGLE_LCD || FORAGER_LEFT || FORAGER_RIGHT

config ZMK_SPLIT
    default y

endif
```

## app/boards/shields/lcd_dongle_forager/Kconfig.shield
```kconfig
config FORAGER_LEFT
    def_bool $(shields_list_contains,forager_left)

config FORAGER_RIGHT
    def_bool $(shields_list_contains,forager_right)

config FORAGER_DONGLE
    def_bool $(shields_list_contains,forager_dongle)

config FORAGER_DONGLE_LCD
    def_bool $(shields_list_contains,forager_dongle_lcd)

config LAYER_ROLLER_ALL_CAPS
    bool "Convert layer names to all caps"
    default n
```

## app/boards/shields/lcd_dongle_forager/boards/seeeduino_xiao_ble.conf
```kconfig
CONFIG_ST7789V_RGB565=y
CONFIG_LV_Z_BITS_PER_PIXEL=16
CONFIG_LV_COLOR_DEPTH_16=y
CONFIG_LV_COLOR_16_SWAP=y
CONFIG_LV_DPI_DEF=218
```
