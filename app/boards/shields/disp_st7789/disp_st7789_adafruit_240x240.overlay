/ {
    chosen {
        zephyr,display = &st7789;
    };
};

&arduino_spi {
    status = "okay";
    cs-gpios = <&arduino_header 16 GPIO_ACTIVE_LOW>;

    st7789: st7789v@0 {
        compatible = "sitronix,st7789v";
        spi-max-frequency = <20000000>;
        reg = <0>;
        cmd-data-gpios = <&arduino_header 15 GPIO_ACTIVE_LOW>;
        reset-gpios = <&arduino_header 14 GPIO_ACTIVE_LOW>;
        width = <240>;
        height = <240>;
        x-offset = <0>;
        y-offset = <0>;
        vcom = <0x19>;
        gctrl = <0x35>;
        vrhs = <0x12>;
        vdvs = <0x20>;
        mdac = <0x00>;
        gamma = <0x01>;
        colmod = <0x05>;
        lcm = <0x2c>;
        porch-param = [ 0c 0c 00 33 33  ];
        cmd2en-param = [ 5a 69 02 01  ];
        pwctrl1-param = [ a4 a1  ];
        pvgam-param = [ D0 04 0D 11 13 2B 3F 54 4C 18 0D 0B 1F 23  ];
        nvgam-param = [ D0 04 0C 11 13 2C 3F 44 51 2F 1F 1F 20 23  ];
        ram-param = [ 00 F0  ];
        rgb-param = [ CD 08 14  ];
    };
};