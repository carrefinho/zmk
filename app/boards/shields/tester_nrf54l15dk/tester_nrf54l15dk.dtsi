/*
 * Copyright (c) 2026 The ZMK Contributors
 *
 * SPDX-License-Identifier: MIT
 *
 * A minimal 4-key-per-half split using the nRF54L15 DK's four on-board
 * push buttons (sw0..sw3) as a direct-GPIO keyscan, so two DKs can stand in
 * for a split keyboard while testing LE Connection Subrating. No wiring
 * needed - press a button to generate key activity and drive the subrate
 * tiers.
 */

#include <dt-bindings/zmk/matrix_transform.h>

/ {
    chosen {
        zmk,kscan = &kscan0;
        zmk,matrix-transform = &default_transform;
    };

    default_transform: keymap_transform_0 {
        compatible = "zmk,matrix-transform";
        columns = <8>;
        rows = <1>;
        map = <
            RC(0,0) RC(0,1) RC(0,2) RC(0,3)    RC(0,4) RC(0,5) RC(0,6) RC(0,7)
        >;
    };

    kscan0: kscan {
        compatible = "zmk,kscan-gpio-direct";
        wakeup-source;

        /* nRF54L15 DK push buttons 0..3 (see nrf54l15dk_common.dtsi). */
        input-gpios
            = <&gpio1 13 (GPIO_ACTIVE_LOW | GPIO_PULL_UP)>
            , <&gpio1  9 (GPIO_ACTIVE_LOW | GPIO_PULL_UP)>
            , <&gpio1  8 (GPIO_ACTIVE_LOW | GPIO_PULL_UP)>
            , <&gpio0  4 (GPIO_ACTIVE_LOW | GPIO_PULL_UP)>
            ;
    };
};
