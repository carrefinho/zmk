/*
 * Copyright (c) 2026 The ZMK Contributors
 *
 * SPDX-License-Identifier: MIT
 */

#include <behaviors.dtsi>
#include <dt-bindings/zmk/keys.h>

/ {
    keymap {
        compatible = "zmk,keymap";

        default_layer {
            /* Left half (central): A B C D   Right half (peripheral): E F G H */
            bindings = <
                &kp A &kp B &kp C &kp D    &kp E &kp F &kp G &kp H
            >;
        };
    };
};
