## app/module/drivers/input/Kconfig
```kconfig
if INPUT

config ZMK_INPUT_MOCK
    bool "Input Mock"
    default y
    depends on DT_HAS_ZMK_INPUT_MOCK_ENABLED

config ZMK_INPUT_SYNTHETIC_MOUSE
    bool "Synthetic mouse (SCI pointing test)"
    default y
    depends on DT_HAS_ZMK_INPUT_SYNTHETIC_MOUSE_ENABLED

endif
```

## app/module/drivers/sensor/iqs231b/Kconfig
```kconfig
menuconfig ZMK_SENSOR_IQS231B
	bool "IQS231B proximity and touch sensor"
	depends on DT_HAS_AZOTEQ_IQS231B_ENABLED && I2C && GPIO
	help
	  Enable driver for Azoteq IQS231B proximity and touch sensor.
	  
	  This driver requires GPIO power control to ensure reliable test mode
	  operation. The power-gpios property must be specified in the device tree.

if ZMK_SENSOR_IQS231B

config ZMK_SENSOR_IQS231B_INIT_PRIORITY
	int "Init priority"
	default 75
	help
	  Device driver initialization priority.

endif # ZMK_SENSOR_IQS231B
```

## app/module/dts/bindings/input/zmk,input-synthetic-mouse.yaml
```yaml
# Copyright (c) 2026 The ZMK Contributors
# SPDX-License-Identifier: MIT

description: |
  Synthetic pointing device for SCI pointing tests: a diagonal triangle-wave of
  relative movement plus mouse buttons driven from board buttons. All output
  goes through the Zephyr input subsystem (forwardable over zmk,input-split).

compatible: "zmk,input-synthetic-mouse"

properties:
  poll-period-ms:
    type: int
    default: 1
    description: Milliseconds between generated movement reports.
  step:
    type: int
    default: 1
    description: Per-report movement on each of X and Y (diagonal).
  amplitude:
    type: int
    default: 200
    description: Accumulated position at which the sweep reverses direction.
  start-enabled:
    type: boolean
    description: Start emitting immediately at boot (else wait for the toggle).
  toggle-gpios:
    type: phandle-array
    description: Active-edge GPIO that toggles the movement stream on/off.
  left-click-gpios:
    type: phandle-array
    description: GPIO reported as INPUT_BTN_0 (left click) on press/release.
  right-click-gpios:
    type: phandle-array
    description: GPIO reported as INPUT_BTN_1 (right click) on press/release.
```

## app/module/dts/bindings/sensor/azoteq,iqs231b.yaml
```yaml
description: |
  Azoteq IQS231B proximity and touch sensor

  This sensor requires GPIO power control to ensure reliable test mode operation.
  The power-gpios property is mandatory to control when the sensor is powered on,
  allowing precise timing for the 340ms test mode window.

compatible: "azoteq,iqs231b"

include: [sensor-device.yaml, i2c-device.yaml]

properties:
  power-gpios:
    type: phandle-array
    required: true
    description: |
      GPIO used to control power to the IQS231B sensor. This is required
      to ensure the test mode communication window (340ms) is available
      after sensor power-on, regardless of bootloader timing.
      
  proximity-threshold:
    type: int
    default: 6
    description: |
      Proximity detection threshold in counts
      4 = 4 counts (most sensitive)
      6 = 6 counts (moderate)  
      8 = 8 counts
      10 = 10 counts (least sensitive)
    enum: [4, 6, 8, 10]
    
  sample-rate-hz:
    type: int
    default: 100
    description: |
      Sensor sample rate in Hz
      4 = 4 Hz (280ms response time)
      8 = 8 Hz (154ms response time)
      30 = 30 Hz (57ms response time)
      100 = 100 Hz (34ms response time)
    enum: [4, 8, 30, 100]
    
  quick-release-threshold:
    type: int
    default: 100
    description: |
      Quick release threshold in counts
      50 = relaxed (50 counts)
      100 = moderate (100 counts)
      150 = strict (150 counts)
      250 = very strict (250 counts)
    enum: [50, 100, 150, 250]
    
  quick-release-beta:
    type: int
    default: 2
    description: |
      Quick release beta (following speed) configuration
      2 = fast following
      3 = moderate following
      4 = moderate following
      5 = slow following
    enum: [2, 3, 4, 5]
    
  increase-debounce:
    type: boolean
    description: |
      Increase debounce filter timing
      If not specified = 6 in, 4 out (default)
      If specified = 12 in, 8 out (increased debounce)
      
  prox-with-movement:
    type: boolean
    description: |
      Enable proximity with movement UI instead of proximity/no movement
      If not specified = Prox / No movement (default)
      If specified = Prox with movement
      
  ac-filter:
    type: int
    default: 2
    description: |
      AC filter level
      0 = Filter disabled (register bits 11)
      1 = Filter level 1 (register bits 00)
      2 = Filter level 2 (register bits 01)
      3 = Filter level 3 (register bits 10)
    enum: [0, 1, 2, 3]
    
  temperature-compensation:
    type: boolean
    description: |
      Enable temperature and interference compensation
      If not specified = Disabled (default)
      If specified = Enabled
      
  quick-release:
    type: boolean
    description: |
      Enable quick release functionality
      If not specified = Disabled (default)
      If specified = Enabled
```

## app/src/split/bluetooth/Kconfig
```kconfig
# Copyright (c) 2022 The ZMK Contributors
# SPDX-License-Identifier: MIT

if ZMK_SPLIT && ZMK_SPLIT_BLE

menu "BLE Transport"

config ZMK_SPLIT_BLE_PRIORITY
    int "BLE transport priority"
    help
        Lower number priorities transports are favored over higher numbers.

# Added for backwards compatibility. New shields / board should set `ZMK_SPLIT_ROLE_CENTRAL` only.
config ZMK_SPLIT_BLE_ROLE_CENTRAL
    bool
    select ZMK_SPLIT_ROLE_CENTRAL

config ZMK_SPLIT_ROLE_CENTRAL
    select BT_CENTRAL
    select BT_GATT_CLIENT
    select BT_GATT_AUTO_DISCOVER_CCC
    select BT_SCAN_WITH_IDENTITY

# Bump this value needed for concurrent GATT discovery of splits
config BT_ATT_TX_COUNT
    default 10 if ZMK_SPLIT_ROLE_CENTRAL

if ZMK_SPLIT_ROLE_CENTRAL

config ZMK_SPLIT_BLE_CENTRAL_PERIPHERALS
    int "Number of peripherals that will connect to the central."

menuconfig ZMK_SPLIT_BLE_CENTRAL_BATTERY_LEVEL_FETCHING
    bool "Fetch Peripheral Battery Level Info"
    help
      Adds internal support for fetching the battery levels from peripherals
      and generating events in the ZMK eventing system.

if ZMK_SPLIT_BLE_CENTRAL_BATTERY_LEVEL_FETCHING

config ZMK_SPLIT_BLE_CENTRAL_BATTERY_LEVEL_QUEUE_SIZE
    int "Max number of battery level events to queue when received from peripherals"
    default ZMK_SPLIT_BLE_CENTRAL_PERIPHERALS

config ZMK_SPLIT_BLE_CENTRAL_BATTERY_LEVEL_PROXY
    bool "Proxy Peripheral Battery Level Info"
    help
      Adds support for reporting the battery levels of connected split
      peripherals through an additional Battery Level service.

endif

config ZMK_SPLIT_BLE_CENTRAL_POSITION_QUEUE_SIZE
    int "Max number of key position state events to queue when received from peripherals"
    default 5

config ZMK_SPLIT_BLE_CENTRAL_SPLIT_RUN_STACK_SIZE
    int "BLE split central write thread stack size"
    default 512

config ZMK_SPLIT_BLE_CENTRAL_SPLIT_RUN_QUEUE_SIZE
    int "Max number of behavior run events to queue to send to the peripheral(s)"
    default 5

config ZMK_SPLIT_BLE_PREF_INT
    int "Connection interval to use for split central/peripheral connection"
    default 6

config ZMK_SPLIT_BLE_PREF_LATENCY
    int "Latency to use for split central/peripheral connection"
    default 30

config ZMK_SPLIT_BLE_PREF_TIMEOUT
    int "Supervision timeout to use for split central/peripheral connection"
    default 400

endif # ZMK_SPLIT_ROLE_CENTRAL

if !ZMK_SPLIT_ROLE_CENTRAL

config ZMK_SPLIT_BLE_PERIPHERAL_STACK_SIZE
    int "BLE split peripheral notify thread stack size"
    default 756

config ZMK_SPLIT_BLE_PERIPHERAL_PRIORITY
    int "BLE split peripheral notify thread priority"
    default 5

config ZMK_SPLIT_BLE_PERIPHERAL_POSITION_QUEUE_SIZE
    int "Max number of key position state events to queue to send to the central"
    default 10

config BT_MAX_PAIRED
    default 1

config BT_MAX_CONN
    default 1

# Allow central to specify connection parameters.
config BT_GAP_AUTO_UPDATE_CONN_PARAMS
    default n

endif # !ZMK_SPLIT_ROLE_CENTRAL

config ZMK_SPLIT_BLE_SCI
    bool "Shorter Connection Intervals (1.25 ms) on the split link [EXPERIMENTAL]"
    select EXPERIMENTAL
    select BT_SHORTER_CONNECTION_INTERVALS
    select BT_SUBRATING
    select BT_LE_EXTENDED_FEAT_SET
    help
      Drive the split central<->peripheral link to a 1.25 ms connection interval
      via the Bluetooth 6.2 Shorter Connection Intervals (RCV) Connection Rate
      Update procedure, pinned at subrate factor 1 (no subrating tiers). The
      central initiates the procedure after the page-1 feature exchange. Requires
      a controller with BT_CTLR_SHORTER_CONNECTION_INTERVALS support. Set on both
      halves (the configs apply to both; the driving logic is central-only).

menuconfig ZMK_SPLIT_BLE_SUBRATING
    bool "LE Connection Subrating on the split link [EXPERIMENTAL]"
    select EXPERIMENTAL
    select BT_SUBRATING
    help
      Enable Bluetooth LE Connection Subrating (Core 5.3) on the split
      central<->peripheral connection. The central drives a three-tier subrate
      ladder (active -> idle -> dormant) off keyboard activity, thinning out its
      connection events as the keyboard goes quiet so it drops toward
      peripheral-latency-class power. Requires a controller with
      BT_CTLR_SUBRATING support.

if ZMK_SPLIT_BLE_SUBRATING && ZMK_SPLIT_ROLE_CENTRAL

# Central-driven tier ladder. A factor of 1 disables subrating for that tier.

config ZMK_SPLIT_BLE_SUBRATE_TIMEOUT
    int "Supervision timeout while subrated (10ms units)"
    default 800
    range 10 3200

config ZMK_SPLIT_BLE_SUBRATE_DORMANT_DELAY
    int "Milliseconds of idle before dropping to the dormant tier"
    default 900000
    range 10000 3600000

# ACTIVE tier (keyboard in use)
config ZMK_SPLIT_BLE_SUBRATE_ACTIVE_MIN
    int "Active subrate factor minimum"
    default 1
    range 1 500

config ZMK_SPLIT_BLE_SUBRATE_ACTIVE_MAX
    int "Active subrate factor maximum"
    default 2
    range 1 500

config ZMK_SPLIT_BLE_SUBRATE_ACTIVE_CN
    int "Active continuation number"
    default 1
    range 0 499

config ZMK_SPLIT_BLE_SUBRATE_ACTIVE_MAX_LATENCY
    int "Active maximum peripheral latency"
    default 15
    range 0 499

# IDLE tier (briefly quiet)
config ZMK_SPLIT_BLE_SUBRATE_IDLE_MIN
    int "Idle subrate factor minimum"
    default 1
    range 1 500

config ZMK_SPLIT_BLE_SUBRATE_IDLE_MAX
    int "Idle subrate factor maximum"
    default 15
    range 1 500

config ZMK_SPLIT_BLE_SUBRATE_IDLE_CN
    int "Idle continuation number"
    default 14
    range 0 499

config ZMK_SPLIT_BLE_SUBRATE_IDLE_MAX_LATENCY
    int "Idle maximum peripheral latency"
    default 2
    range 0 499

# DORMANT tier (long idle)
config ZMK_SPLIT_BLE_SUBRATE_DORMANT_MIN
    int "Dormant subrate factor minimum"
    default 1
    range 1 500

config ZMK_SPLIT_BLE_SUBRATE_DORMANT_MAX
    int "Dormant subrate factor maximum"
    default 80
    range 1 500

config ZMK_SPLIT_BLE_SUBRATE_DORMANT_CN
    int "Dormant continuation number"
    default 20
    range 0 499

config ZMK_SPLIT_BLE_SUBRATE_DORMANT_MAX_LATENCY
    int "Dormant maximum peripheral latency"
    default 0
    range 0 499

endif # ZMK_SPLIT_BLE_SUBRATING && ZMK_SPLIT_ROLE_CENTRAL

endmenu

endif # ZMK_SPLIT_BLE
```
